&mmp_dsi_panel {
	dsi_s6d7aa0x_boe_wxga_vid: marvell,dsi-panel-s6d7aa0x-boe-wxga-video {
		marvell,dsi-panel-manu = "BOE";     /* condensed manufacturer name */
		marvell,dsi-panel-model = "BP070WX1-300";
		marvell,dsi-panel-name = "s6d7aa0x-boe";
		marvell,dsi-panel-id = <0x5EB810>;
		marvell,dsi-panel-type = "video_mode";
		marvell,dsi-panel-xres = <800>;
		marvell,dsi-panel-yres = <1280>;
		marvell,dsi-panel-width= <94>;      /* screen width in mm */
		marvell,dsi-panel-height = <150>;   /* screen height in mm */
		marvell,dsi-h-front-porch = <16>;   /* right margin */
		marvell,dsi-h-back-porch = <48>;    /* left margin */
		marvell,dsi-h-sync-width = <16>;    /* hsync len */
		marvell,dsi-v-front-porch = <8>;    /* lower margin */
		marvell,dsi-v-back-porch = <6>;     /* upper margin */
		marvell,dsi-v-sync-width = <2>;     /* vsync len */
		marvell,dsi-hsync-invert = <0>;     /* hsync invert */
		marvell,dsi-vsync-invert = <0>;     /* vsync invert */
		marvell,dsi-lanes = <4>;
		marvell,dsi-burst-mode = <2>;
		marvell,dsi-master-mode;
		marvell,dsi-hfp-en;
		marvell,dsi-hbp-en;
		/*
		 * DSI PACKET HEADER INFO
		 * @ data type : 1byte
		 * @ delay(msec) : 2byte
		 * @ size of data : 2byte
		 */
		marvell,dsi-panel-init-cmds = [
			39 00 00 00 03	F0 5A 5A
			39 00 00 00 03	F1 5A 5A
			39 00 00 00 03	FC A5 A5
			39 00 01 00 03	D0 00 10
			39 00 00 00 04	C3 CF 00 2A
			39 00 00 00 04	BC 01 4E 0A
			39 00 00 00 06	FD 16 10 11 23 09
			39 00 00 00 07	FE 00 02 03 21 00 78
			39 00 00 00 04	F2 02 08 08
			15 00 78 00 02	11 00
			15 00 00 00 02	35 00
			15 00 00 00 02	29 00
		];
		marvell,dsi-panel-init-cmds-txmode = "dsi-lp-mode";
		marvell,dsi-panel-enable-cmds = [];
		marvell,dsi-panel-enable-cmds-txmode = "dsi-hs-mode";
		marvell,dsi-panel-disable-cmds = [
			05 00 28 00 01	28
			05 00 78 00 01	10
		];
		marvell,dsi-panel-disable-cmds-txmode = "dsi-hs-mode";
		/*
		 * [MDNIE LITE]
		 * To enable : marvell,dsi-panel-mdnie-support
		 * To disable : marvell,dsi-panel-mdnie-not-support
		 */
		marvell,dsi-panel-mdnie-support;
		marvell,dsi-panel-mdnie-cmd-reg = [E6];
		marvell,dsi-panel-mdnie-cmd-len = <0x71>;
		marvell,dsi-panel-mdnie-ui-mode-cmds = [
			39 00 00 00 11	E8 00 00 00 00 00 00 00 00 00 00 00 00 00 00 00
					00
			39 00 00 00 19	E9 00 FF FF 00 FF 00 FF 00 00 FF FF 00 FF 00 FF
					00 00 FF FF 00 FF 00 FF 00
			39 00 00 00 19	EA 00 20 00 20 00 20 00 20 00 20 00 20 00 20 00
					20 00 20 00 20 00 20 00 20
			39 00 00 00 19	EB 00 20 00 20 00 20 00 20 00 20 00 20 00 20 00
					20 00 20 00 20 00 20 00 FF
			39 00 00 00 13	EC 04 7E 1F 96 1F EC 1F CA 04 4A 1F EC 1F CA 1F
					97 04 9F
			39 00 00 00 08	E7 08 03 03 20 05 00 02
		];
		marvell,dsi-panel-mdnie-ui-mode-cmds-txmode = "dsi-hs-mode";
		marvell,dsi-panel-mdnie-video-mode-cmds = [
			39 00 00 00 11	E8 00 00 00 00 00 00 00 00 00 00 00 00 00 00 00
					00
			39 00 00 00 19	E9 00 FF FF 00 FF 00 FF 00 00 FF FF 00 FF 00 FF
					00 00 FF FF 00 FF 00 FF 00
			39 00 00 00 19	EA 00 20 00 20 00 20 00 20 00 20 00 20 00 20 00
					20 00 20 00 20 00 20 00 20
			39 00 00 00 19	EB 00 20 00 20 00 20 00 20 00 20 00 20 00 20 00
					20 00 20 00 20 00 20 00 FF
			39 00 00 00 13	EC 04 7E 1F 96 1F EC 1F CA 04 4A 1F EC 1F CA 1F
					97 04 9F
			39 00 00 00 08	E7 08 03 03 20 05 00 06
		];
		marvell,dsi-panel-mdnie-video-mode-cmds-txmode = "dsi-hs-mode";
		marvell,dsi-panel-mdnie-camera-mode-cmds = [
			39 00 00 00 11	E8 00 00 00 00 00 00 00 00 00 00 00 00 00 00 00
					00
			39 00 00 00 19	E9 00 FF FF 00 FF 00 FF 00 00 FF FF 00 FF 00 FF
					00 00 FF FF 00 FF 00 FF 00
			39 00 00 00 19	EA 00 20 00 20 00 20 00 20 00 20 00 20 00 20 00
					20 00 20 00 20 00 20 00 20
			39 00 00 00 19	EB 00 20 00 20 00 20 00 20 00 20 00 20 00 20 00
					20 00 20 00 20 00 20 00 FF
			39 00 00 00 13	EC 04 7E 1F 96 1F EC 1F CA 04 4A 1F EC 1F CA 1F
					97 04 9F
			39 00 00 00 08	E7 08 03 03 20 05 00 02
		];
		marvell,dsi-panel-mdnie-camera-mode-cmds-txmode = "dsi-hs-mode";
		marvell,dsi-panel-mdnie-gallery-mode-cmds = [
			39 00 00 00 11	E8 00 00 00 00 00 00 00 00 00 00 00 00 00 00 00
					00
			39 00 00 00 19	E9 00 FF FF 00 FF 00 FF 00 00 FF FF 00 FF 00 FF
					00 00 FF FF 00 FF 00 FF 00
			39 00 00 00 19	EA 00 20 00 20 00 20 00 20 00 20 00 20 00 20 00
					20 00 20 00 20 00 20 00 20
			39 00 00 00 19	EB 00 20 00 20 00 20 00 20 00 20 00 20 00 20 00
					20 00 20 00 20 00 20 00 FF
			39 00 00 00 13	EC 04 7E 1F 96 1F EC 1F CA 04 4A 1F EC 1F CA 1F
					97 04 9F
			39 00 00 00 08	E7 08 03 03 20 05 00 06
		];
		marvell,dsi-panel-mdnie-gallery-mode-cmds-txmode = "dsi-hs-mode";
		marvell,dsi-panel-mdnie-negative-mode-cmds = [
			39 00 00 00 11	E8 00 00 00 00 00 00 00 00 00 00 00 00 00 00 00
					00
			39 00 00 00 19	E9 FF 00 00 FF 00 FF 00 FF FF 00 00 FF 00 FF 00
					FF FF 00 00 FF 00 FF 00 FF
			39 00 00 00 19	EA 00 20 00 20 00 20 00 20 00 20 00 20 00 20 00
					20 00 20 00 20 00 20 00 20
			39 00 00 00 19	EB 00 20 00 20 00 20 00 20 00 20 00 20 00 20 00
					20 00 20 00 20 00 20 00 FF
			39 00 00 00 13	EC 04 00 00 00 00 00 00 00 04 00 00 00 00 00 00
					00 04 00
			39 00 00 00 08	E7 08 30 03 20 05 00 00
		];
		marvell,dsi-panel-mdnie-negative-mode-cmds-txmode = "dsi-hs-mode";
		marvell,dsi-panel-mdnie-vt-mode-cmds = [
			39 00 00 00 11	E8 00 00 00 00 00 00 00 00 00 00 00 00 00 00 00
					00
			39 00 00 00 19	E9 00 FF FF 00 FF 00 FF 00 00 FF FF 00 FF 00 FF
					00 00 FF FF 00 FF 00 FF 00
			39 00 00 00 19	EA 00 20 00 20 00 20 00 20 00 20 00 20 00 20 00
					20 00 20 00 20 00 20 00 20
			39 00 00 00 19	EB 00 20 00 20 00 20 00 20 00 20 00 20 00 20 00
					20 00 20 00 20 00 20 00 FF
			39 00 00 00 13	EC 04 7E 1F 96 1F EC 1F CA 04 4A 1F EC 1F CA 1F
					97 04 9F
			39 00 00 00 08	E7 08 03 03 20 05 00 06
		];
		marvell,dsi-panel-mdnie-vt-mode-cmds-txmode = "dsi-hs-mode";
		marvell,dsi-panel-mdnie-browser-mode-cmds = [
			39 00 00 00 11	E8 00 00 00 00 00 00 00 00 00 00 00 00 00 00 00
					00
			39 00 00 00 19	E9 00 FF FF 00 FF 00 FF 00 00 FF FF 00 FF 00 FF
					00 00 FF FF 00 FF 00 FF 00
			39 00 00 00 19	EA 00 20 00 20 00 20 00 20 00 20 00 20 00 20 00
					20 00 20 00 20 00 20 00 20
			39 00 00 00 19	EB 00 20 00 20 00 20 00 20 00 20 00 20 00 20 00
					20 00 20 00 20 00 20 00 FF
			39 00 00 00 13	EC 04 7E 1F 96 1F EC 1F CA 04 4A 1F EC 1F CA 1F
					97 04 9F
			39 00 00 00 08	E7 08 03 03 20 05 00 02
		];
		marvell,dsi-panel-mdnie-browser-mode-cmds-txmode = "dsi-hs-mode";
			marvell,dsi-panel-mdnie-ebook-mode-cmds = [
			39 00 00 00 11	E8 00 00 00 00 00 00 00 00 00 00 00 00 00 00 00
					00
			39 00 00 00 19	E9 00 FF FF 00 FF 00 FF 00 00 FF FF 00 FF 00 FF
					00 00 FF F5 00 FF 00 E4 00
			39 00 00 00 19	EA 00 20 00 20 00 20 00 20 00 20 00 20 00 20 00
					20 00 20 00 20 00 20 00 20
			39 00 00 00 19	EB 00 20 00 20 00 20 00 20 00 20 00 20 00 20 00
					20 00 20 00 20 00 20 00 FF
			39 00 00 00 13	EC 04 00 00 00 00 00 00 00 04 00 00 00 00 00 00
					00 04 00
			39 00 00 00 08	E7 08 30 03 20 05 00 00
		];
		marvell,dsi-panel-mdnie-ebook-mode-cmds-txmode = "dsi-hs-mode";
		marvell,dsi-panel-mdnie-email-mode-cmds = [
			39 00 00 00 11	E8 00 00 00 00 00 00 00 00 00 00 00 00 00 00 00
					00
			39 00 00 00 19	E9 00 FF FF 00 FF 00 FF 00 00 FF FF 00 FF 00 FF
					00 00 FF FD 00 FF 00 F4 00
			39 00 00 00 19	EA 00 20 00 20 00 20 00 20 00 20 00 20 00 20 00
					20 00 20 00 20 00 20 00 20
			39 00 00 00 19	EB 00 20 00 20 00 20 00 20 00 20 00 20 00 20 00
					20 00 20 00 20 00 20 00 FF
			39 00 00 00 13	EC 04 00 00 00 00 00 00 00 04 00 00 00 00 00 00
					00 04 00
			39 00 00 00 08	E7 08 30 03 20 05 00 00
		];
		marvell,dsi-panel-mdnie-email-mode-cmds-txmode = "dsi-hs-mode";
		marvell,dsi-panel-mdnie-color-adjustment-mode-cmds = [
			39 00 00 00 11	E8 00 00 00 00 00 00 00 00 00 00 00 00 00 00 00
					00
			39 00 00 00 19	E9 00 FF FF 00 FF 00 FF 00 00 FF FF 00 FF 00 FF
					00 00 FF FF 00 FF 00 FF 00
			39 00 00 00 19	EA 00 20 00 20 00 20 00 20 00 20 00 20 00 20 00
					20 00 20 00 20 00 20 00 20
			39 00 00 00 19	EB 00 20 00 20 00 20 00 20 00 20 00 20 00 20 00
					20 00 20 00 20 00 20 00 FF
			39 00 00 00 13	EC 04 00 00 00 00 00 00 00 04 00 00 00 00 00 00
					00 04 00
			39 00 00 00 08	E7 08 30 03 20 05 00 00
		];
		marvell,dsi-panel-mdnie-color-adjustment-mode-cmds-txmode = "dsi-hs-mode";
		marvell,dsi-panel-backlight-on-cmds = [
			15 00 00 00 02	53 24
		];
		marvell,dsi-panel-backlight-on-cmds-txmode = "dsi-hs-mode";
		marvell,dsi-panel-backlight-set-brightness-cmds = [
			15 00 00 00 02	51 57
		];
		marvell,dsi-panel-backlight-set-brightness-cmds-txmode = "dsi-hs-mode";
		marvell,dsi-panel-backlight-get-brightness-reg = [52];
		marvell,dsi-panel-read-id-regs = [DA DB DC];
		marvell,dsi-panel-read-status-reg = [0A];
		marvell,dsi-panel-read-status-ok = [9A];
		status = "okay";
	};
};
