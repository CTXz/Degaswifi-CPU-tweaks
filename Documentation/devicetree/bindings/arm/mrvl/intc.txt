## Documentation/devicetree/bindings/arm/mrvl/intc.txt
```
* Marvell MMP Interrupt controller

Required properties:
- compatible : Should be "mrvl,mmp-intc", "mrvl,mmp2-intc" or
  "mrvl,mmp2-mux-intc", "mrvl,mmp-intc-wakeupgen"
- reg : Address and length of the register set of the interrupt controller.
  If the interrupt controller is intc, address and length means the range
  of the whold interrupt controller. If the interrupt controller is mux-intc,
  address and length means one register. Since address of mux-intc is in the
  range of intc. mux-intc is secondary interrupt controller.
- reg-names : Name of the register set of the interrupt controller. It's
  only required in mux-intc interrupt controller.
- interrupts : Should be the port interrupt shared by mux interrupts. It's
  only required in mux-intc interrupt controller.
- interrupt-controller : Identifies the node as an interrupt controller.
- #interrupt-cells : Specifies the number of cells needed to encode an
  interrupt source.
- mrvl,intc-gbl-mask : Specifies the address and value for global mask in the
  interrupt controller.
- mrvl,intc-for-cp : Specifies the irqs that will be routed to cp
- mrvl,intc-nr-irqs : Specifies the number of interrupts in the interrupt
  controller.
- mrvl,clr-mfp-irq : Specifies the interrupt that needs to clear MFP edge
  detection first.
- mrvl,inct-wake-clr: Specifies the device interrupt and mask bits that needs
  to be cleared in ISR. Here the device refers to SD, Keypad etc, if system is
  wake up by it, MMP DE added some logic in PMU to assert a signal to interrupt
  controller, and we have to write APMU_WAKE_CLR register related bit to deassert
  this signal which keeps triggering interrupt.It’s due to SD card insert/remove
  or keypad press may need some time to be detected (debounce time), and DE want
  to avoid to enter LPM again to lose this event.

Example:
	intc: interrupt-controller@d4282000 {
		compatible = "mrvl,mmp2-intc";
		interrupt-controller;
		#interrupt-cells = <1>;
		reg = <0xd4282000 0x1000>;
		mrvl,intc-nr-irqs = <64>;
	};

	intcmux4@d4282150 {
		compatible = "mrvl,mmp2-mux-intc";
		interrupts = <4>;
		interrupt-controller;
		#interrupt-cells = <1>;
		reg = <0x150 0x4>, <0x168 0x4>;
		reg-names = "mux status", "mux mask";
		mrvl,intc-nr-irqs = <2>;
	};

	intc: interrupt-controller@d4282000 {
		compatible = "mrvl,mmp-intc";
		reg = <0xd4282000 0x1000>;
		mrvl,intc-wakeup = <0x114 0x3
		                    0x144 0x3>;
	};

* Marvell Orion Interrupt controller

Required properties
- compatible :  Should be "marvell,orion-intc".
- #interrupt-cells: Specifies the number of cells needed to encode an
  interrupt source. Supported value is <1>.
- interrupt-controller : Declare this node to be an interrupt controller.
- reg : Interrupt mask address. A list of 4 byte ranges, one per controller.
        One entry in the list represents 32 interrupts.

Example:

	intc: interrupt-controller {
        	compatible = "marvell,orion-intc", "marvell,intc";
		interrupt-controller;
		#interrupt-cells = <1>;
                reg = <0xfed20204 0x04>,
		      <0xfed20214 0x04>;
        };
```

## arch/arm/mach-mmp/Kconfig
```kconfig
if ARCH_MMP

menu "Marvell PXA168/910/MMP2 Implmentations"

config MACH_ASPENITE
	bool "Marvell's PXA168 Aspenite Development Board"
	select CPU_PXA168
	help
	  Say 'Y' here if you want to support the Marvell PXA168-based
	  Aspenite Development Board.

config MACH_ZYLONITE2
	bool "Marvell's PXA168 Zylonite2 Development Board"
	select CPU_PXA168
	help
	  Say 'Y' here if you want to support the Marvell PXA168-based
	  Zylonite2 Development Board.

config MACH_AVENGERS_LITE
	bool "Marvell's PXA168 Avengers Lite Development Board"
	select CPU_PXA168
	help
	  Say 'Y' here if you want to support the Marvell PXA168-based
	  Avengers Lite Development Board.

config MACH_TAVOREVB
	bool "Marvell's PXA910 TavorEVB Development Board"
	select CPU_PXA910
	help
	  Say 'Y' here if you want to support the Marvell PXA910-based
	  TavorEVB Development Board.

config MACH_TTC_DKB
	bool "Marvell's PXA910 TavorEVB Development Board"
	select CPU_PXA910
	help
	  Say 'Y' here if you want to support the Marvell PXA910-based
	  TTC_DKB Development Board.

config MACH_BROWNSTONE
	bool "Marvell's Brownstone Development Platform"
	depends on !CPU_MOHAWK
	select CPU_MMP2
	help
	  Say 'Y' here if you want to support the Marvell MMP2-based
	  Brown Development Platform.
	  MMP2-based board can't be co-existed with PXA168-based &
	  PXA910-based development board. Since MMP2 is compatible to
	  ARMv7 architecture.

config MACH_FLINT
	bool "Marvell's Flint Development Platform"
	depends on !CPU_MOHAWK
	select CPU_MMP2
	help
	  Say 'Y' here if you want to support the Marvell MMP2-based
	  Flint Development Platform.
	  MMP2-based board can't be co-existed with PXA168-based &
	  PXA910-based development board. Since MMP2 is compatible to
	  ARMv7 architecture.

config MACH_MARVELL_JASPER
	bool "Marvell's Jasper Development Platform"
	depends on !CPU_MOHAWK
	select CPU_MMP2
	help
	  Say 'Y' here if you want to support the Marvell MMP2-base
	  Jasper Development Platform.
	  MMP2-based board can't be co-existed with PXA168-based &
	  PXA910-based development board. Since MMP2 is compatible to
	  ARMv7 architecture.

config MACH_TETON_BGA
	bool "Marvell's PXA168 Teton BGA Development Board"
	select CPU_PXA168
	help
	  Say 'Y' here if you want to support the Marvell PXA168-based
	  Teton BGA Development Board.

config MACH_GPLUGD
	bool "Marvell's PXA168 GuruPlug Display (gplugD) Board"
	select CPU_PXA168
	help
	  Say 'Y' here if you want to support the Marvell PXA168-based
	  GuruPlug Display (gplugD) Board

config MACH_MMP_DT
	bool "Support MMP (ARMv5) platforms from device tree"
	select CPU_PXA168
	select CPU_PXA910
	select USE_OF
	select PINCTRL
	select PINCTRL_SINGLE
	help
	  Include support for Marvell MMP2 based platforms using
	  the device tree. Needn't select any other machine while
	  MACH_MMP_DT is enabled.

config MACH_MMP2_DT
	bool "Support MMP2 (ARMv7) platforms from device tree"
	depends on !CPU_MOHAWK
	select CPU_MMP2
	select USE_OF
	select PINCTRL
	select PINCTRL_SINGLE
	help
	  Include support for Marvell MMP2 based platforms using
	  the device tree.

config MACH_MMPX_DT
	bool "Support no-PJ/PJ4(ARMv7) platforms from device tree"
	depends on !CPU_MOHAWK && !CPU_PJ4
	select CPU_PXA988
	select USE_OF
config MACH_DEGAS
	bool "Samsung's PXA1088 DEGAS Development Board"
	select CPU_PXA1088
	help
	  Say 'Y' here if you want to support the Samsung PXA1088-based
	  DEGAS Development Board.
	  DEGAS board is an evalutation board, not phone like.	  
	select PINCTRL
	select PINCTRL_SINGLE
	help
	  Include support for Marvell MMP2 based platforms using
	  the device tree.

config MACH_DEGAS_USA
	bool "Samsung's PXA1088 DEGAS Development Board"
	select CPU_PXA1088
	help
	  Say 'Y' here if you want to support the Samsung PXA1088-based
	  DEGAS Development Board.
	  DEGAS board is an evalutation board, not phone like.
	select PINCTRL
	select PINCTRL_SINGLE
	help
	  Include support for Marvell MMP2 based platforms using
	  the device tree.

config MACH_AGERA
	bool "Samsung's PXA1L88 AGERA Development Board"
	help
	  Say 'Y' here if you want to support the Samsung PXA1L88-based
	  AGERA Development Board.
	  AGERA board is an evalutation board, not phone like.
	help
	  Include support for Marvell MMP2 based platforms using
	  the device tree.

config MACH_KAVERI
	bool "Samsung's PXA1L88 KAVERI Development Board"
	help
	  Say 'Y' here if you want to support the Samsung PXA1L88-based
	  KAVERI Development Board.
	  KAVERI board is an evalutation board, not phone like.
	help
	  Include support for Marvell MMP2 based platforms using
	  the device tree.

config MACH_AJANTA
	bool "Samsung's PXA1L88 AJANTA Development Board"
	help
	  Say 'Y' here if you want to support the Samsung PXA1L88-based
	  AJANTA Development Board.
	  AJANTA board is an evalutation board, not phone like.
	help
	  Include support for Marvell MMP2 based platforms using
	  the device tree.

config MACH_MOUTAI
	bool "Samsung's PXA1L88 MOUTAI Development Board"
	help
	  Say 'Y' here if you want to support the Samsung PXA1L88-based
	  MOUTAI Development Board.
	  MOUTAI board is an evalutation board, not phone like.
	help
	  Include support for Marvell MMP2 based platforms using
	  the device tree.
 
config MACH_SEC_DT
	bool "Support no-PJ/PJ4(ARMv7) platforms from device tree"
	depends on !CPU_MOHAWK && !CPU_PJ4
	select CPU_PXA988
	select USE_OF
	select CLKSRC_OF
	select PINCTRL
	select PINCTRL_SINGLE
	help
	  Include support for Marvell MMP2 based platforms using
	  the device tree.

config MACH_EDEN_DT
	bool "Support EDEN(ARMv7) platforms from device tree"
	depends on !CPU_MOHAWK && !CPU_PJ4
	select CPU_EDEN
	select CLKSRC_OF
	select USE_OF
	select PINCTRL
	select PINCTRL_SINGLE
	help
	  Include support for Marvell EDEN based platforms using
	  the device tree.

config MACH_ADIR_DT
	bool "Support Adir(ARMv7) platforms from device tree"
	depends on !CPU_MOHAWK && !CPU_PJ4
	select CPU_PXA1986
	select USE_OF
	help
	  Include support for Marvell PXA1986 SoC based
	  using the device tree.

endmenu

config CPU_PXA168
	bool
	select COMMON_CLK
	select CPU_MOHAWK
	help
	  Select code specific to PXA168

config CPU_PXA910
	bool
	select COMMON_CLK
	select CPU_MOHAWK
	help
	  Select code specific to PXA910

config CPU_PXA988
	bool
	select CPU_V7
	select ARM_GIC
	select HAVE_SMP
	select HAVE_ARM_SCU
	select LOCAL_TIMERS
	select HAVE_ARM_TWD
	select COMMON_CLK
	select CLKSRC_OF
	select MIGHT_HAVE_CACHE_L2X0
	select ARM_HAS_SG_CHAIN
	select CORESIGHT_SUPPORT
	select CORESIGHT_TRACE_SUPPORT
	select ARCH_HAS_OPP
	help
	  Say 'Y' here if you want to support the Marvell pxa988-base
	  platforms.
	  PXA988 is an SoC with dual-core Cotex-A9 and comunication
	  processor, code name "Emei".

config CPU_EDEN
	bool
	select CPU_CA7MP
	select COMMON_CLK
	select ARM_HAS_SG_CHAIN
	select CORESIGHT_SUPPORT
	select CORESIGHT_TRACE_SUPPORT
	select ARCH_HAS_OPP
	help
	  Support for EDEN processors based on the ARM Cortex-A7 MP CPU.
	  Select code specific to EDEN

config CPU_PXA1986
	bool
	select CPU_CA7MP
	select COMMON_CLK
	select ARM_THUMBEE
	select HAVE_ARM_SCU
	select CLKSRC_OF
	select ARM_HAS_SG_CHAIN
	help
	  Say 'Y' here if you want to support the Marvell pxa1986-base
	  platforms.
	  PXA1986 is an SoC with dual-core Cortex-A15 and communication
	  processor, code name "Adir".

config CPU_CA7MP
	bool
	select CPU_V7
	select ARM_GIC
	select HAVE_SMP
	help
	  Select code specific to Cortex A7

config CPU_MMP2
	bool
	select COMMON_CLK
	select CPU_PJ4
	help
	  Select code specific to MMP2. MMP2 is ARMv7 compatible.

config USB_EHCI_MV_U2O
        bool "EHCI support for PXA USB OTG controller"
	depends on USB_EHCI_MV
	help
	  Enables support for OTG controller which can be switched to host mode.

config CORESIGHT_SUPPORT
	bool "support coresight features"
	help
	  Support coresight features such as dump pcsr, trigger panic etc.

config CORESIGHT_TRACE_SUPPORT
	bool "support save/restore coresight trace setting when enter/exit LPM"
	depends on CORESIGHT_SUPPORT
	help
	  Enables support save/restore coresight trace setting when enter/exit LPM.

config TZ_HYPERVISOR
	bool "Enable TrustZone security feature"
	help
	  This option enables TrustZone security feature. With TrustZone
	  enabled, the kernel will run under non-secure state and access
	  secure resources via TZLC (TrustZone light calling).

config GPU_RESERVE_MEM
	bool "GC video memory allocator"
	default y
	help
	  reserve memory for GC as video memory

config SAMSUNG_PRODUCT_SHIP
	bool "set up for product shipping"
	default n

endif
```

## arch/arm/plat-pxa/Kconfig
```kconfig
if PLAT_PXA

config PXA_SSP
	tristate
	help
	  Enable support for PXA2xx SSP ports

config PXA_PANIC_FLUSH
        bool "PXA cache flush when panic"
        depends on KEXEC
        help
          Enable support for flush all cache during panic

config DUMP_REGS
       bool
       default n
       depends on (ARCH_PXA || ARCH_MMP)
       help
         Dump soc registers, stack, and possible functions in the stack
endif
```

## drivers/clk/mmp/Kconfig
```kconfig
menuconfig MRVL_MMP_CLK_FULL_FEAT
	bool "Marvell MMP Clock Full features"
	depends on ARCH_MMP && COMMON_CLK
	default y
	help
	  Enable full features of clock for Marvell MMP architecture.

if MRVL_MMP_CLK_FULL_FEAT
config PXA_DVFS
	tristate "Enable DVFS feature"
	depends on ARCH_MMP && COMMON_CLK
	default y
	help
	  Enable Dynamic Voltage & Frequency Scaling feature.
endif
```

## drivers/marvell/Kconfig
```kconfig
menuconfig MARVELL_DRIVERS
	bool "Marvell kernel module drivers"
	help
		marvell kernel module drivers

if MARVELL_DRIVERS
config MRVL_GPU_GALCORE
	tristate "Marvell Graphics Kernel Mode Driver"
	default n
	help
		If you say Y here, graphics kernel mode driver named galcore
		will be built into uImage.

		To compile this driver as a module, choose M here: the driver
		will be compiled into a separate module galcore.ko.

		If you want to disable GPU hardware totally, just select N here.

config MRVL_MMP_MODEM
       tristate "Marvell mmp modem driver"
       default n
       help
               marvell mmp modem driver for communication processor

config SSIPC_SUPPORT
       bool "SSIPC feature"
	   depends on MRVL_MMP_MODEM
       default n
       help
               support SSIPC feature

config MRVL_GEU
       tristate "Marvell driver for generic encrypt unit"
       default n
       help
               driver for generic encrypt unit

config GRAPHICS_PXA1920
	tristate "enable graphics for pxa1920"
	help
		Say Y here to enable the support of graphics core
		for chipset pxa1920

config GRAPHICS_PXA1088
	tristate "enable graphics for pxa1088"
	help
		Say Y here to enable the support of graphics core
		for chipset pxa1088

config MRVL_TZDD
       tristate "Marvell Trust Zone Device Driver"
       default n
       help
               Marvell Trust Execution Environment (TEE) Solution in non-trusted world

config SEC_GPU_FREQ_CONTROL
       bool "SEC specific user control for GPU"
       depends on MRVL_GPU_GALCORE
       default n
       help
               Enabling this will provide sys fs nodes for GPU frequency control from
	       user space required for CFMS.

endif
```
