## drivers/media/platform/soc_camera/Kconfig
```kconfig
config SOC_CAMERA
	tristate "SoC camera support"
	depends on VIDEO_V4L2 && HAS_DMA && I2C
	select VIDEOBUF_GEN
	select VIDEOBUF2_CORE
	help
	  SoC Camera is a common API to several cameras, not connecting
	  over a bus like PCI or USB. For example some i2c camera connected
	  directly to the data bus of an SoC.

config SOC_CAMERA_PLATFORM
	tristate "platform camera support"
	depends on SOC_CAMERA
	help
	  This is a generic SoC camera platform driver, useful for testing

config MX1_VIDEO
	bool

config VIDEO_MX1
	tristate "i.MX1/i.MXL CMOS Sensor Interface driver"
	depends on BROKEN
	depends on VIDEO_DEV && ARCH_MX1 && SOC_CAMERA
	select FIQ
	select VIDEOBUF_DMA_CONTIG
	select MX1_VIDEO
	---help---
	  This is a v4l2 driver for the i.MX1/i.MXL CMOS Sensor Interface

config MX3_VIDEO
	bool

config VIDEO_MX3
	tristate "i.MX3x Camera Sensor Interface driver"
	depends on VIDEO_DEV && MX3_IPU && SOC_CAMERA
	select VIDEOBUF2_DMA_CONTIG
	select MX3_VIDEO
	---help---
	  This is a v4l2 driver for the i.MX3x Camera Sensor Interface

config VIDEO_PXA27x
	tristate "PXA27x Quick Capture Interface driver"
	depends on VIDEO_DEV && PXA27x && SOC_CAMERA
	select VIDEOBUF_DMA_SG
	---help---
	  This is a v4l2 driver for the PXA27x Quick Capture Interface

config VIDEO_SH_MOBILE_CSI2
	tristate "SuperH Mobile MIPI CSI-2 Interface driver"
	depends on VIDEO_DEV && SOC_CAMERA && HAVE_CLK
	---help---
	  This is a v4l2 driver for the SuperH MIPI CSI-2 Interface

config VIDEO_SH_MOBILE_CEU
	tristate "SuperH Mobile CEU Interface driver"
	depends on VIDEO_DEV && SOC_CAMERA && HAS_DMA && HAVE_CLK
	select VIDEOBUF2_DMA_CONTIG
	---help---
	  This is a v4l2 driver for the SuperH Mobile CEU Interface

config VIDEO_OMAP1
	tristate "OMAP1 Camera Interface driver"
	depends on VIDEO_DEV && ARCH_OMAP1 && SOC_CAMERA
	select VIDEOBUF_DMA_CONTIG
	select VIDEOBUF_DMA_SG
	---help---
	  This is a v4l2 driver for the TI OMAP1 camera interface

config VIDEO_MX2_HOSTSUPPORT
	bool

config VIDEO_MX2
	tristate "i.MX27 Camera Sensor Interface driver"
	depends on VIDEO_DEV && SOC_CAMERA && MACH_MX27
	select VIDEOBUF2_DMA_CONTIG
	select VIDEO_MX2_HOSTSUPPORT
	---help---
	  This is a v4l2 driver for the i.MX27 Camera Sensor Interface

config VIDEO_ATMEL_ISI
	tristate "ATMEL Image Sensor Interface (ISI) support"
	depends on VIDEO_DEV && SOC_CAMERA && ARCH_AT91
	select VIDEOBUF2_DMA_CONTIG
	---help---
	  This module makes the ATMEL Image Sensor Interface available
	  as a v4l2 device.

config VIDEO_MMP
	tristate "Marvell MMP CCIC driver based on SOC_CAMERA"
	depends on VIDEO_DEV && SOC_CAMERA
	select VIDEOBUF2_DMA_CONTIG
	select DMA_SHARED_BUFFER
	---help---
	  This is a v4l2 driver for the Marvell PXA910/PXA688/PXA2128 CCIC
	  To compile this driver as a module, choose M here: the module will
	  be called mmp_camera.

config CCICS_CLK_COUPLED
	bool "Marvell MMP CCICs Clock Coupled"
	depends on VIDEO_MMP
	---help---
	  On some Marvell boards, CCIC2 clock depends on CCIC1 clock
	  To make CCIC2 clock work, CCIC1 clock must be enabled
	  first.
	  If you don't know how to config this option, just don't touch
	  this option and leave it as it is.
```

## drivers/misc/sec-debug/Kconfig
```kconfig
menuconfig SEC_DEBUG
        bool "Samsung TN Ramdump Feature"
        default n
        help
          Samsung TN Ramdump Feature. Use INFORM3 and magic number at 0xc0000000.

if SEC_DEBUG
config SEC_DEBUG_SCHED_LOG
        bool "Samsung Scheduler Logging Feature"
        default n
        help
          Samsung Scheduler Logging Feature for Debug use.

config SEC_DEBUG_SOFTIRQ_LOG
        bool "Samsung Softirq Logging Feature"
        default n
        depends on SEC_DEBUG_SCHED_LOG
        help
          Samsung Softirq Logging Feature for Debug use.
          This option enables us to log softirq enter/exit.
          It is not only hard-irq which results in scheduler lockup,
          To be more clear we need to see also softirq logs.

config SEC_DEBUG_TIMER_LOG
        bool "Samsung Timer Logging Feature"
        default n
        help
          Samsung Timer Logging Feature for Debug use.
endif

config SEC_LOG
        bool "Samsung log buffer"
        default n

config SEC_LOG_LAST_KMSG
        bool "Samsung Use Sec Log Last Kmsg"
        depends on SEC_LOG
        default n
        help
           This feature creats a node to read contents of sec_log_buf
           area just before booting into kernel from bootloader.
           This is very helpful to read sec_log_buf area without reset
           or entering upload mode.

config USER_RESET_DEBUG
	bool "Reset reason debug feature in user version"
	default n
	help
	  This option provides reset history log in user version.
	  This option enable proc/reset_reason support

config MACH_PXA_SAMSUNG
        bool "PXA based Samsung board type"
        depends on ARCH_MMP
        default n
        help
          PXA based samsung board configuration option.
```

## drivers/net/wireless/sd8887/Kconfig
```kconfig
menuconfig MRVL_SD8887
	tristate "Marvell sd8887 Driver"
	default n

config MRVL_SD8887_WIFI
	tristate "Marvell sd8887_WIFI Driver"
	depends on MRVL_SD8887
	default n
	---help---
	  Marvell sd8887 wifi driver.

config MRVL_SD8887_BT
	tristate "Marvell sd8887_BT Driver"
	depends on MRVL_SD8887
	default n
	---help---
	  Marvell sd8887 bt driver.
```

## drivers/sensors/Kconfig
```kconfig
# drivers/sensors/Kconfig
#
# Copyright (C) 2013 Samsung Electronics Co, Ltd.
#
# This software is licensed under the terms of the GNU General Public
# License version 2, as published by the Free Software Foundation, and
# may be copied, distributed, and modified under those terms.
#
# This program is distributed in the hope that it will be useful,
# but WITHOUT ANY WARRANTY; without even the implied warranty of
# MERCHANTABILITY or FITNESS FOR A PARTICULAR PURPOSE.  See the
# GNU General Public License for more details.
#

config SENSORS
        bool "Sensors Support"
        help
          Say Y to enable Sensors support.  This allows control of supported
          Sensors.

config CONFIG_SENSORS
	tristate "Sensors core"
	default n
	help
	  Say Y here to enable debugging messages for power supply class
	  and drivers.

config SENSORS_GP2A002S
	tristate "gp2a proximity_sensor"
	default n
	help
	  This option enables magnetic sensors using gp2a002s proximity driver.

config SENSORS_GP2AP020A00F
	depends on I2C
	bool "Sharp GP2AP020A00F driver"
	default n

config SENSORS_GP2A030
	depends on I2C
	tristate "GP2AP030 driver"
	default n
	help
	  This option enables proximity & light sensors using gp2ap030 driver.

config SENSORS_BMA2X2
	tristate "BMA255/BMA250E/BMA222E/BMA280 acceleration sensor support"
	depends on I2C=y
	help
	  If you say yes here you get support for Bosch Sensortec's
	  acceleration sensors BMA255/BMA250E/BMA222E/BMA280.

config SENSORS_BMM050
	tristate "BMM050 Magnetic Sensor Driver"
	depends on I2C=y
	help
	 BMM050 Magnetic Sensor Driver implemented by Bosch-Sensortec.

config INPUT_BMA2x2_ACC_ALERT_INT
	tristate "BMA255/BMA250E/BMA222E/BMA280 acceleration sensor support"
	depends on I2C=y
	help
	  If you say yes here you get support for Bosch Sensortec's
	  acceleration sensors BMA255/BMA250E/BMA222E/BMA280.

config SENSORS_BMA254
	tristate "BMA254 Acceleration Sensor Driver"
	depends on I2C
	default n
	help
	  If you say yes here you get support for Bosch-Sensortec's
	  BMA254 Acceleration Sensor.

config INPUT_BMA254_ACC_ALERT_INT
	tristate "BMA254 acceleration sensor motion support"
	depends on SENSORS_BMA254
	default n
	help
	  If you say yes here you get support for Bosch Sensortec's
	  acceleration sensors BMA254 Motion support.

config SENSORS_TMD27723
	tristate "TMD27723 Proximity & Light Sensor Driver"
	depends on I2C
	default n
	help
	  If you say yes here you get support for TAOS's
	  TMD27723 Proximity & Light Sensor.

config SENSORS_GRIP_SX9500
	depends on I2C
	tristate "SEMTECH grip sensor driver"
	default n
	help
	  Say Y here if you use GP2A_PROXIMITY.
	  This option enables proximity sensors using
	  SHARP GP2A_ANALOG device driver.

	  Say N here if you do not use GRIP_SX9500.

config SENSORS_ACCELOMETER_BMA25X
	depends on I2C
	tristate "BOSCH acceleromter sensor driver"
	default n
	help
	  Say Y here if you use GP2A_PROXIMITY.
	  This option enables proximity sensors using
	  SHARP GP2A_ANALOG device driver.

	  Say N here if you do not use SENSORS_ACCELOMETER_BMA25X.

config COND_N_POWER_USE
	bool "grip cond_n_power_use"
	depends on SENSORS_GRIP_SX9500

config SENSORS_SX9500_INIT_TOUCH_THRESHOLD
	int "SX9500 Grip sensor threshold for init touch"
	depends on SENSORS_GRIP_SX9500
	default "3000"
	help
	  This value is the standard of init touch using
	  SemTech sx9500 device driver.

config SENSORS_SX9500_NORMAL_TOUCH_THRESHOLD
	int "SX9500 Grip sensor threshold for normal touch"
	depends on SENSORS_GRIP_SX9500
	default "17"
	help
	  This value is the standard of normal touch using
	  SemTech sx9500 device driver.

config SENSOR_USE_SYMLINK
	bool "sensors_symlink"
	depends on I2C
```

## drivers/video/mmp/hw/Kconfig
```kconfig
if MMP_DISP

config MMP_DISP_CONTROLLER
	bool "mmp display controller hw support"
	default y
	help
		Marvell MMP display hw controller support

config MMP_DISP_DFC
	bool "mmp display controller dfc support"
	depends on MMP_DISP_CONTROLLER
	default n
	help
		Marvell MMP display freqency change feature support
		change between pll1 and pll3, this config shoud used
		with DIP channel solution together

config MMP_DISP_SPI
	bool "mmp display controller spi port"
	depends on MMP_DISP_CONTROLLER && SPI_MASTER
	default y
	help
		Marvell MMP display hw controller spi port support
		will register as a spi master for panel usage

config MMP_VIRTUAL_RESOLUTION
	bool "support virtual resulution"
	depends on MMP_DISP_CONTROLLER
	default n
	help
		Enable virtual resolution feature to support simulate
		some resolution which current panel can't support or
		no such panel of resolution

config MMP_VIRTUAL_RESOLUTION_X
	int "virtual resolution x (0~1920)"
	depends on MMP_VIRTUAL_RESOLUTION
	range 0 1920
	default 720
	help
		Set the x resolution for virtual resolution

config MMP_VIRTUAL_RESOLUTION_Y
	int "virtual resolution y (0~1920)"
	depends on MMP_VIRTUAL_RESOLUTION
	range 0 1920
	default 1280
	help
		Set the y resolution for virtual resolution
endif
```

## drivers/video/mmp/panel/Kconfig
```kconfig
config MMP_PANEL_BACKLIGHT
	bool "mmp panel backlighg support"
	default n
	help
		mmp panel backlight support.
		It is controlled by command of LDI.

config MMP_PANEL_MDNIE
	bool "mDNIe-LITE support"
	default n
	help
		mDNIe-LITE support

config MMP_PANEL_TFT_GENERIC
	bool "MIPI Generic TFT-LCD support"
	default n
	help
		MIPI Generic TFT-LCD support

config MMP_PANEL_TPOHVGA
	bool "tpohvga panel TJ032MD01BW support"
	depends on SPI_MASTER
	default n
	help
		tpohvga panel support

config MMP_PANEL_NT35565
	bool "MIPI panel NT35565 support"
	default n
	help
		MIPI panel NT35565 support

config MMP_PANEL_R63311
	bool "MIPI Sharp panel R63311 support"
	default n
	help
		MIPI Sharp 1080p panel support

config MMP_PANEL_LG4591
	bool "MIPI panel LG4591 support"
	default n
	help
		MIPI panel LG4591 support

config MMP_PANEL_OTM1281A
	bool "MIPI panel OTM1281A support"
	default n
	help
		MIPI panel OTM1281A support

config MMP_PANEL_TD043MGEA1
	bool "parallel panel TD043MGEA1 support"
	default n
	help
		parallel panel TD043MGEA1 support

config MMP_PANEL_NT35510
	bool "MIPI panel NT35510 support"
	default n
	help
		MIPI panel NT35510 support

config MMP_PANEL_S6D7AA0X
	bool "MIPI panel S6D7AA0X support"
	default n
	help
		MIPI panel SD67AA0X support

config MMP_PANEL_EA8868B
	bool "MIPI panel EA8868B support"
	default n
	help
		MIPI panel EA8868B support

config MMP_PANEL_SC7798A
	bool "MIPI panel SC7798A support"
	default n
	help
		MIPI panel SC7798A support

config MMP_PANEL_TFT1080P_1E
	bool "MIPI TFT panel 1080p support"
	default n
	help
		MIPI TFT 1080p panel support
```
